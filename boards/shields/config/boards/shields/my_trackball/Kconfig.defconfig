## boards/shields/config/boards/shields/my_trackball/Kconfig.defconfig
```kconfig
if SHIELD_MY_TRACKBALL

config ZMK_KEYBOARD_NAME
    default "My Trackball"

endif
```

## config/west.yml
```yaml
manifest:
  remotes:
    - name: zmkfirmware
      url-base: https://github.com/zmkfirmware
    - name: alyx-brett
      url-base: https://github.com/alyx-brett
  projects:
    - name: zmk
      remote: zmkfirmware
      revision: main
      import: app/west.yml
    - name: zmk-driver-pmw3320
      remote: alyx-brett
      revision: main
  self:
    path: config
```
